## drivers/char/Kconfig.rej
```kconfig
--- drivers/char/Kconfig
+++ drivers/char/Kconfig
@@ -580,6 +580,7 @@ config TELCLOCK
 
 config DEVPORT
 	bool
+	depends on !M68K
 	depends on ISA || PCI
 	default y
 
```
